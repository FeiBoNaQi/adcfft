/* USER CODE BEGIN Header */
/**
  ******************************************************************************
  * @file           : main.c
  * @brief          : Main program body
  ******************************************************************************
  * @attention
  *
  * <h2><center>&copy; Copyright (c) 2021 STMicroelectronics.
  * All rights reserved.</center></h2>
  *
  * This software component is licensed by ST under BSD 3-Clause license,
  * the "License"; You may not use this file except in compliance with the
  * License. You may obtain a copy of the License at:
  *                        opensource.org/licenses/BSD-3-Clause
  *
  ******************************************************************************
  */
/* USER CODE END Header */
/* Includes ------------------------------------------------------------------*/
#include "main.h"
#include "adc.h"
#include "dfsdm.h"
#include "dma.h"
#include "i2c.h"
#include "quadspi.h"
#include "spi.h"
#include "tim.h"
#include "usart.h"
#include "usb_otg.h"
#include "gpio.h"
#include "main.h"

/* Private includes ----------------------------------------------------------*/
/* USER CODE BEGIN Includes */
#include <string.h>
#include <stdio.h>
#include <math.h>
/* USER CODE END Includes */

/* Private typedef -----------------------------------------------------------*/
/* USER CODE BEGIN PTD */

/* USER CODE END PTD */

/* Private define ------------------------------------------------------------*/
/* USER CODE BEGIN PD */
#define ADC_BUF_LEN 2048
/* USER CODE END PD */

/* Private macro -------------------------------------------------------------*/
/* USER CODE BEGIN PM */

/* USER CODE END PM */

/* Private variables ---------------------------------------------------------*/

/* USER CODE BEGIN PV */
double phase1_585;
double phase1_586;
double phase2_585;
double phase2_586;
int adc_conv_flag=0;
uint16_t adc1_buf[ADC_BUF_LEN];
uint16_t adc2_buf[ADC_BUF_LEN];
const static double fft_ratio_585_R[1024]={1,-0.901348847046009,0.624859488142369,-0.225083911359784,-0.219101240156856,0.620057211763243,-0.898674465693875,0.999981175282500,-0.903989293123340,0.629638238914848,-0.231058108280641,-0.213110319916053,0.615231590580517,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0.624859488132848,-0.901348847032519};
const static double fft_ratio_585_I[1024]={0,0.433093818853145,-0.780737228572071,0.974339382785533,-0.975702130038472,0.784556597155520,-0.438616238538492,0.00613588464915646,0.427555093430230,-0.776888465673129,0.972939952205419,-0.977028142657600,0.788346427626472,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0.780737228560799,-0.433093818847096};
const static double fft_ratio_586_R[1024]={1,-0.898674465693941,0.615231590580610,-0.207111376192211,-0.242980179903248,0.643831542889743,-0.914209755703450,0.999322384588248,-0.881921264348254,0.585797857456365,-0.170961888760280,-0.278519689385005,0.671558954846898,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0.615231590571212,-0.898674465680466};
const static double fft_ratio_586_I[1024]={0,0.438616238538521,-0.788346427626583,0.978317370719585,-0.970031253194488,0.765167265622405,-0.405241314004957,-0.0368072229413524,0.471396736825940,-0.810457198252487,0.985277642388798,-0.960430519415414,0.740951125354833,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0.788346427615175,-0.438616238532378};
/* USER CODE END PV */

/* Private function prototypes -----------------------------------------------*/
void SystemClock_Config(void);
void PeriphCommonClock_Config(void);
/* USER CODE BEGIN PFP */

/* USER CODE END PFP */

/* Private user code ---------------------------------------------------------*/
/* USER CODE BEGIN 0 */

/* USER CODE END 0 */

/**
  * @brief  The application entry point.
  * @retval int
  */
int main(void)
{
  /* USER CODE BEGIN 1 */

  /* USER CODE END 1 */

  /* MCU Configuration--------------------------------------------------------*/

  /* Reset of all peripherals, Initializes the Flash interface and the Systick. */
  HAL_Init();

  /* USER CODE BEGIN Init */

  /* USER CODE END Init */

  /* Configure the system clock */
  SystemClock_Config();

/* Configure the peripherals common clocks */
  PeriphCommonClock_Config();

  /* USER CODE BEGIN SysInit */

  /* USER CODE END SysInit */

  /* Initialize all configured peripherals */
  MX_GPIO_Init();
  MX_DMA_Init();
  MX_ADC1_Init();
  MX_DFSDM1_Init();
  MX_I2C2_Init();
  MX_QUADSPI_Init();
  MX_SPI3_Init();
  MX_USART1_UART_Init();
  MX_USART3_UART_Init();
  MX_USB_OTG_FS_PCD_Init();
  MX_TIM1_Init();
  MX_ADC2_Init();
  /* USER CODE BEGIN 2 */
  HAL_ADC_Start_DMA(&hadc2, (uint32_t*)adc2_buf, ADC_BUF_LEN);
  HAL_ADC_Start_DMA(&hadc1, (uint32_t*)adc1_buf, ADC_BUF_LEN);

  HAL_TIM_Base_Start_IT(&htim1);
  /* USER CODE END 2 */

  /* Infinite loop */
  /* USER CODE BEGIN WHILE */
#define RUNNING_SUM_LENGTH (10)
  double running_sum[RUNNING_SUM_LENGTH];
  int i=0;
  while (1)
  {
      if(adc_conv_flag == 0x03){
          double phase_585 = phase1_585 - phase2_585;
          double phase_586 = phase1_586 - phase2_586;
          //if (phase_585<0) phase_585+=3.141592653589;
          //if (phase_586<0) phase_586+=3.141592653589;
          double temp = (phase_585*6+phase_586)/7;
          if (temp<0) temp+=3.141592653589;
          running_sum[i] = temp;
          i = (i+1)%10;
          double average_shif=0;
          for(int j=0;j<RUNNING_SUM_LENGTH;j++)
          {
              average_shif+=running_sum[j];
          }
          average_shif /=10;
          uint8_t distance[10];
          snprintf(distance,10,"%lf\r\n",average_shif);
          HAL_UART_Transmit(&huart1,distance,7,10);
          adc_conv_flag=0;
      }
    /* USER CODE END WHILE */

    /* USER CODE BEGIN 3 */
  }
  /* USER CODE END 3 */
}

/**
  * @brief System Clock Configuration
  * @retval None
  */
void SystemClock_Config(void)
{
  RCC_OscInitTypeDef RCC_OscInitStruct = {0};
  RCC_ClkInitTypeDef RCC_ClkInitStruct = {0};

  /** Configure the main internal regulator output voltage
  */
  if (HAL_PWREx_ControlVoltageScaling(PWR_REGULATOR_VOLTAGE_SCALE1) != HAL_OK)
  {
    Error_Handler();
  }
  /** Configure LSE Drive Capability
  */
  HAL_PWR_EnableBkUpAccess();
  __HAL_RCC_LSEDRIVE_CONFIG(RCC_LSEDRIVE_LOW);
  /** Initializes the RCC Oscillators according to the specified parameters
  * in the RCC_OscInitTypeDef structure.
  */
  RCC_OscInitStruct.OscillatorType = RCC_OSCILLATORTYPE_LSE|RCC_OSCILLATORTYPE_MSI;
  RCC_OscInitStruct.LSEState = RCC_LSE_ON;
  RCC_OscInitStruct.MSIState = RCC_MSI_ON;
  RCC_OscInitStruct.MSICalibrationValue = 0;
  RCC_OscInitStruct.MSIClockRange = RCC_MSIRANGE_6;
  RCC_OscInitStruct.PLL.PLLState = RCC_PLL_ON;
  RCC_OscInitStruct.PLL.PLLSource = RCC_PLLSOURCE_MSI;
  RCC_OscInitStruct.PLL.PLLM = 1;
  RCC_OscInitStruct.PLL.PLLN = 77;
  RCC_OscInitStruct.PLL.PLLP = RCC_PLLP_DIV7;
  RCC_OscInitStruct.PLL.PLLQ = RCC_PLLQ_DIV2;
  RCC_OscInitStruct.PLL.PLLR = RCC_PLLR_DIV4;
  if (HAL_RCC_OscConfig(&RCC_OscInitStruct) != HAL_OK)
  {
    Error_Handler();
  }
  /** Initializes the CPU, AHB and APB buses clocks
  */
  RCC_ClkInitStruct.ClockType = RCC_CLOCKTYPE_HCLK|RCC_CLOCKTYPE_SYSCLK
                              |RCC_CLOCKTYPE_PCLK1|RCC_CLOCKTYPE_PCLK2;
  RCC_ClkInitStruct.SYSCLKSource = RCC_SYSCLKSOURCE_PLLCLK;
  RCC_ClkInitStruct.AHBCLKDivider = RCC_SYSCLK_DIV1;
  RCC_ClkInitStruct.APB1CLKDivider = RCC_HCLK_DIV1;
  RCC_ClkInitStruct.APB2CLKDivider = RCC_HCLK_DIV1;

  if (HAL_RCC_ClockConfig(&RCC_ClkInitStruct, FLASH_LATENCY_4) != HAL_OK)
  {
    Error_Handler();
  }
  /** Enable MSI Auto calibration
  */
  HAL_RCCEx_EnableMSIPLLMode();
}

/**
  * @brief Peripherals Common Clock Configuration
  * @retval None
  */
void PeriphCommonClock_Config(void)
{
  RCC_PeriphCLKInitTypeDef PeriphClkInit = {0};

  /** Initializes the peripherals clock
  */
  PeriphClkInit.PeriphClockSelection = RCC_PERIPHCLK_USB|RCC_PERIPHCLK_ADC;
  PeriphClkInit.AdcClockSelection = RCC_ADCCLKSOURCE_PLLSAI1;
  PeriphClkInit.UsbClockSelection = RCC_USBCLKSOURCE_PLLSAI1;
  PeriphClkInit.PLLSAI1.PLLSAI1Source = RCC_PLLSOURCE_MSI;
  PeriphClkInit.PLLSAI1.PLLSAI1M = 1;
  PeriphClkInit.PLLSAI1.PLLSAI1N = 24;
  PeriphClkInit.PLLSAI1.PLLSAI1P = RCC_PLLP_DIV7;
  PeriphClkInit.PLLSAI1.PLLSAI1Q = RCC_PLLQ_DIV2;
  PeriphClkInit.PLLSAI1.PLLSAI1R = RCC_PLLR_DIV2;
  PeriphClkInit.PLLSAI1.PLLSAI1ClockOut = RCC_PLLSAI1_48M2CLK|RCC_PLLSAI1_ADC1CLK;
  if (HAL_RCCEx_PeriphCLKConfig(&PeriphClkInit) != HAL_OK)
  {
    Error_Handler();
  }
}

/* USER CODE BEGIN 4 */
//fft
void fft(int order,ADC_HandleTypeDef* hadc)
{
    double sum_585_r=0;
    double sum_585_i=0;
    double sum_586_r=0;
    double sum_586_i=0;
    if(hadc == &hadc1 && ((adc_conv_flag & 0x01) !=0x01)){
        for (int i = 0; i < 1024; i++) {
            sum_585_r += adc1_buf[i + order * 1024] * fft_ratio_585_R[i];
            sum_585_i += adc1_buf[i + order * 1024] * fft_ratio_585_I[i];
            sum_586_r += adc1_buf[i + order * 1024] * fft_ratio_586_R[i];
            sum_586_i += adc1_buf[i + order * 1024] * fft_ratio_586_I[i];
        }
        phase1_585 = atan(sum_585_i/sum_585_r);
        phase1_586 = atan(sum_586_i/sum_586_r);
        adc_conv_flag = adc_conv_flag | 0x01;
    } else if (hadc == &hadc2 && ((adc_conv_flag & 0x02) !=0x02)) {
        for (int i = 0; i < 1024; i++) {
            sum_585_r += adc2_buf[i + order * 1024] * fft_ratio_585_R[i];
            sum_585_i += adc2_buf[i + order * 1024] * fft_ratio_585_I[i];
            sum_586_r += adc2_buf[i + order * 1024] * fft_ratio_586_R[i];
            sum_586_i += adc2_buf[i + order * 1024] * fft_ratio_586_I[i];
        }
        phase2_585 = atan(sum_585_i/sum_585_r);
        phase2_586 = atan(sum_586_i/sum_586_r);
        adc_conv_flag = adc_conv_flag | 0x02;
    }
}

// Called when first half of buffer is filled
void HAL_ADC_ConvHalfCpltCallback(ADC_HandleTypeDef* hadc) {
    fft(0,hadc);
    if(hadc == &hadc1){
        //HAL_UART_Transmit(&huart1,"half\r\n",6,10);
    }
}

// Called when buffer is completely filled
void HAL_ADC_ConvCpltCallback(ADC_HandleTypeDef* hadc) {
    fft(1,hadc);
    if(hadc == &hadc1){
        HAL_GPIO_TogglePin(GPIOB,GPIO_PIN_2);
        //HAL_UART_Transmit(&huart1,"full\r\n",10,10);
    }
}
/* USER CODE END 4 */

/**
  * @brief  This function is executed in case of error occurrence.
  * @retval None
  */
void Error_Handler(void)
{
  /* USER CODE BEGIN Error_Handler_Debug */
  /* User can add his own implementation to report the HAL error return state */
  __disable_irq();
  while (1)
  {
  }
  /* USER CODE END Error_Handler_Debug */
}

#ifdef  USE_FULL_ASSERT
/**
  * @brief  Reports the name of the source file and the source line number
  *         where the assert_param error has occurred.
  * @param  file: pointer to the source file name
  * @param  line: assert_param error line source number
  * @retval None
  */
void assert_failed(uint8_t *file, uint32_t line)
{
  /* USER CODE BEGIN 6 */
  /* User can add his own implementation to report the file name and line number,
     ex: printf("Wrong parameters value: file %s on line %d\r\n", file, line) */
  /* USER CODE END 6 */
}
#endif /* USE_FULL_ASSERT */

/************************ (C) COPYRIGHT STMicroelectronics *****END OF FILE****/
